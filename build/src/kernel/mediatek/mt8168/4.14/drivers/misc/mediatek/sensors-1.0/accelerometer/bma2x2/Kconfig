## build/src/kernel/mediatek/mt8168/4.14/drivers/misc/mediatek/sensors-1.0/accelerometer/bma2x2/Kconfig
```kconfig
config MTK_BMA2X2
	bool "BMA2x2 for MediaTek package"
	default n
	help
	  It support different accelerometer sensor.
	  If this option is set,
	  it will support
	  BMA2x2 Accelerometer.
```

## build/src/kernel/mediatek/mt8168/4.14/drivers/misc/mediatek/sensors-1.0/accelerometer/mc34xx/Kconfig
```kconfig
config MTK_MC34XX
	bool "MC34xx for MediaTek package"
	default n
	help
	  It support different accelerometer sensor.
	  If this option is set,
	  it will support
	  MC34xx Accelerometer.
```

## build/src/kernel/mediatek/mt8168/4.14/drivers/misc/mediatek/sensors-1.0/accelerometer/stk8baxx/Kconfig
```kconfig
config MTK_STK8BAXX
	bool "STK8BAxx for MediaTek package"
	default n
	help
	  It support different accelerometer sensor.
	  If this option is set,
	  it will support
	  STK8BAxx Accelerometer.
```

## build/src/kernel/mediatek/mt8168/4.14/drivers/misc/mediatek/thermal/Kconfig
```kconfig
config MTK_THERMAL_PA_VIA_ATCMD
	bool "Thermal switch for query modem RF temp"
	help
	  Internal switch for thermal management
	  to query modem RF temperature
	  via AT command.
	  (RIL sockets)

config COOLER_ADAPTIVE_BTS
	bool "Change the reference bts thermal zone for adaptive cooler"
	help
	  change mainboard thermal zone from MTK_THERMAL_SENSOR_AP
	  to MTK_THERMAL_SENSOR_BTS0 for getting right ntc temperature
	  and adaptive cooler.

config CLATM_CHOOSE_HIGHER_TARGET_TJ
	bool "adaptive cooler will choose the one who has higher target Tj"
	help
	  Change ATM decide TTj logic.
	  It will choose the adaptive cooler with higher Target Tj
	  and use the higher trip point as target Tj
	  when more than one adaptive active.
	default n
```

## build/src/kernel/mediatek/mt8168/4.14/drivers/power/supply/mediatek/amzn_ld/Kconfig
```kconfig
config AMZN_LD
	tristate "AMZN_LD driver"
	depends on PUBADC_MANAGE
	default n
	help
	  Say Y here to enable support for type-c CC and SBU protection
```

## build/src/kernel/mediatek/mt8168/4.14/drivers/power/supply/mediatek/max20342/Kconfig
```kconfig
config MAX20342
	tristate "max20342 driver"
	depends on I2C
	default n
	help
	  Say Y here to enable support for type-c CC and SBU protection
	  IC MAX20342.
```

## build/src/kernel/mediatek/mt8168/4.14/drivers/power/supply/mediatek/pubadc_manage/Kconfig
```kconfig
config PUBADC_MANAGE
	tristate "pubadc_manage driver"
	default n
	help
	  Say Y here to enable support public adc management.
```

## build/src/kernel/mediatek/mt8168/4.14/drivers/power/supply/mediatek/wpc/Kconfig
```kconfig
config WPC_IDTP922X
	tristate "idtp922X wireless power driver"
	depends on I2C
	default n
	help
		Say Y here to enable support for the idtp922X wireless power.
```
